## src/buildroot/buildroot-2012.02-mango2450/package/autologin/Config.in
```kconfig
config BR2_PACKAGE_AUTOLOGIN
       bool "autologin"
       default y
       help
         The autologin utility allows to create a set of device files
         according to a configuration file.
```

## src/buildroot/buildroot-2012.02-mango2450/package/libqwt/Config.in
```kconfig
config BR2_PACKAGE_LIBQWT
	bool "libqwt"
	depends on BR2_PACKAGE_QT
	help
	  Qwt is a graphics extension to the Qt GUI application framework. It provides a 2D plotting widget and more.

	  http://http://sourceforge.net/projects/qwt

if BR2_PACKAGE_LIBQWT

config BR2_PACKAGE_LIBQWT_SVG
	bool "SVG support"
	select BR2_PACKAGE_QT_SVG

config BR2_PACKAGE_LIBQWT_MATHML
	bool "MathML support"

endif

comment "libqwt requires qt"
	depends on !BR2_PACKAGE_QT
```

## src/buildroot/buildroot-2012.02-mango2450/package/qwt/Config.in
```kconfig
comment "Qwt requires Qt to be installed"
	depends on !BR2_PACKAGE_QT

menuconfig BR2_PACKAGE_QWT
	bool "Qwt"
	depends on BR2_PACKAGE_QT
	help
	  Qt Widgets for Technical Applications

	  http://qwt.sourceforge.net/
```
